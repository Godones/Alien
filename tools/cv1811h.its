## tools/cv1811h.its
```
/*
 * U-Boot uImage source file for "Alien-cv1811h"
 */

/dts-v1/;

/ {
    description = "U-Boot uImage source file for Alien cv1811h";
    #address-cells = <1>;

    images {
        kernel {
            description = "Linux kernel for Alien-cv1811h";
            data = /incbin/("../alien.bin");
            type = "kernel";
            arch = "riscv";
            os = "linux";
            compression = "none";
            load = <0x80200000>;
            entry = <0x80200000>;
        };
        fdt {
            description = "Flattened Device Tree blob for Alien-cv1811h";
            data = /incbin/("./cv1811h.dtb");
            type = "flat_dt";
            arch = "riscv";
            compression = "none";
        };
    };

    configurations {
        default = "conf";
        conf {
            description = "Boot Linux kernel with FDT blob";
            kernel = "kernel";
            fdt = "fdt";
        };
    };
};
```

## tools/vf2.its
```
/*
 * U-Boot uImage source file for "Alien-vf2"
 */

/dts-v1/;

/ {
    description = "U-Boot uImage source file for Alien vf2";
    #address-cells = <1>;

    images {
        kernel {
            description = "Linux kernel for Alien-vf2";
            data = /incbin/("../alien.bin");
            type = "kernel";
            arch = "riscv";
            os = "linux";
            compression = "none";
            load = <0x40200000>;
            entry = <0x40200000>;
        };
        initrd {
            description = "Initrd";
            data = /incbin/("./initrd/initramfs.cpio.gz");
            type = "ramdisk";
            arch = "riscv";
            os = "linux";
            load = <0x46100000>;
            entry = <0x46100000>;
            compression = "none";
        };
        fdt {
            description = "Flattened Device Tree blob for Alien-vf2";
            data = /incbin/("./jh7110-visionfive-v2.dtb");
            type = "flat_dt";
            arch = "riscv";
            compression = "none";
        };
    };

    configurations {
        default = "conf";
        conf {
            description = "Boot Linux kernel with FDT blob";
            kernel = "kernel";
            fdt = "fdt";
            ramdisk = "initrd";
        };
    };
};
```
